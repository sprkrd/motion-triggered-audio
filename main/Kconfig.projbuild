## main/Kconfig.projbuild
```kconfig
menu "Motion Triggered Audio Player"

    orsource "$IDF_PATH/examples/common_components/env_caps/$IDF_TARGET/Kconfig.env_caps"

    config GPIO_MOTION_SENSOR
        int "Movement sensor input GPIO"
        range ENV_GPIO_RANGE_MIN ENV_GPIO_IN_RANGE_MAX
        default 8 if IDF_TARGET_ESP32C2 || IDF_TARGET_ESP32H2
        default 18
        help
            GPIO pin number to catch the signal of the PIR movement sensors.

    config SD_PIN_MOSI
        int "MOSI GPIO number"
        default 15 if IDF_TARGET_ESP32
        default 35 if IDF_TARGET_ESP32S2
        default 35 if IDF_TARGET_ESP32S3
        default 5  if IDF_TARGET_ESP32H2
        default 11 if IDF_TARGET_ESP32P4
        default 4  # C3 and others

    config SD_PIN_MISO
        int "MISO GPIO number"
        default 2 if IDF_TARGET_ESP32
        default 37 if IDF_TARGET_ESP32S2
        default 37 if IDF_TARGET_ESP32S3
        default 0  if IDF_TARGET_ESP32H2
        default 13 if IDF_TARGET_ESP32P4
        default 6  # C3 and others

    config SD_PIN_CLK
        int "CLK GPIO number"
        default 14 if IDF_TARGET_ESP32
        default 36 if IDF_TARGET_ESP32S2
        default 36 if IDF_TARGET_ESP32S3
        default 4  if IDF_TARGET_ESP32H2
        default 12 if IDF_TARGET_ESP32P4
        default 5  # C3 and others

    config SD_PIN_CS
        int "CS GPIO number"
        default 13 if IDF_TARGET_ESP32
        default 34 if IDF_TARGET_ESP32S2
        default 34 if IDF_TARGET_ESP32S3
        default 10 if IDF_TARGET_ESP32P4
        default 1  # C3 and others

endmenu
```
